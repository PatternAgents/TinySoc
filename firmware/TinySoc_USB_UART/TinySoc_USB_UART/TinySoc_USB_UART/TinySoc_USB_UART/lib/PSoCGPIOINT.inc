;  Generated by PSoC Designer 5.4.2946
;
; LED_1Pin address and mask equates
LED_1Pin_Data_ADDR:	equ	4h
LED_1Pin_DriveMode_0_ADDR:	equ	104h
LED_1Pin_DriveMode_1_ADDR:	equ	105h
LED_1Pin_DriveMode_2_ADDR:	equ	7h
LED_1Pin_GlobalSelect_ADDR:	equ	6h
LED_1Pin_IntCtrl_0_ADDR:	equ	106h
LED_1Pin_IntCtrl_1_ADDR:	equ	107h
LED_1Pin_IntEn_ADDR:	equ	5h
LED_1Pin_MASK:	equ	8h
LED_1Pin_MUXBusCtrl_ADDR:	equ	1d9h
; LED_1Pin_Data access macros
;   GetLED_1Pin_Data macro, return in a
macro GetLED_1Pin_Data
	mov		a,[Port_1_Data_SHADE]
	and		a, 8h
endm
;   SetLED_1Pin_Data macro
macro SetLED_1Pin_Data
	or		[Port_1_Data_SHADE], 8h
	mov		a, [Port_1_Data_SHADE]
	mov		reg[LED_1Pin_Data_ADDR], a
endm
;   ClearLED_1Pin_Data macro
macro ClearLED_1Pin_Data
	and		[Port_1_Data_SHADE], ~8h
	mov		a, [Port_1_Data_SHADE]
	mov		reg[LED_1Pin_Data_ADDR], a
endm

; TX address and mask equates
TX_Data_ADDR:	equ	4h
TX_DriveMode_0_ADDR:	equ	104h
TX_DriveMode_1_ADDR:	equ	105h
TX_DriveMode_2_ADDR:	equ	7h
TX_GlobalSelect_ADDR:	equ	6h
TX_IntCtrl_0_ADDR:	equ	106h
TX_IntCtrl_1_ADDR:	equ	107h
TX_IntEn_ADDR:	equ	5h
TX_MASK:	equ	20h
TX_MUXBusCtrl_ADDR:	equ	1d9h
; TX_Data access macros
;   GetTX_Data macro, return in a
macro GetTX_Data
	mov		a,[Port_1_Data_SHADE]
	and		a, 20h
endm
;   SetTX_Data macro
macro SetTX_Data
	or		[Port_1_Data_SHADE], 20h
	mov		a, [Port_1_Data_SHADE]
	mov		reg[TX_Data_ADDR], a
endm
;   ClearTX_Data macro
macro ClearTX_Data
	and		[Port_1_Data_SHADE], ~20h
	mov		a, [Port_1_Data_SHADE]
	mov		reg[TX_Data_ADDR], a
endm

; RX address and mask equates
RX_Data_ADDR:	equ	4h
RX_DriveMode_0_ADDR:	equ	104h
RX_DriveMode_1_ADDR:	equ	105h
RX_DriveMode_2_ADDR:	equ	7h
RX_GlobalSelect_ADDR:	equ	6h
RX_IntCtrl_0_ADDR:	equ	106h
RX_IntCtrl_1_ADDR:	equ	107h
RX_IntEn_ADDR:	equ	5h
RX_MASK:	equ	80h
RX_MUXBusCtrl_ADDR:	equ	1d9h
; RX_Data access macros
;   GetRX_Data macro, return in a
macro GetRX_Data
	mov		a,[Port_1_Data_SHADE]
	and		a, 80h
endm
;   SetRX_Data macro
macro SetRX_Data
	or		[Port_1_Data_SHADE], 80h
	mov		a, [Port_1_Data_SHADE]
	mov		reg[RX_Data_ADDR], a
endm
;   ClearRX_Data macro
macro ClearRX_Data
	and		[Port_1_Data_SHADE], ~80h
	mov		a, [Port_1_Data_SHADE]
	mov		reg[RX_Data_ADDR], a
endm

